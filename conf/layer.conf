## conf/layer.conf
```bitbake
BBPATH .= ":${LAYERDIR}"

# We have recipes-* directories, add to BBFILES
BBFILES += "${LAYERDIR}/recipes-*/*/*.bb \
            ${LAYERDIR}/recipes-*/*/*.bbappend"

BBFILE_COLLECTIONS += "qti-connectivity"
BBFILE_PATTERN_qti-connectivity := "^${LAYERDIR}"
BBFILE_PRIORITY_qti-connectivity = "12"
LAYERSERIES_COMPAT_qti-connectivity = "mickledore nanbield scarthgap styhead walnascar whinlatter"
```
