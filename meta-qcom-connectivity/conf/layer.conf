## meta-qcom-connectivity/conf/layer.conf
```bitbake
# Downstream connectivity (Congo WLAN) additions for QLI.

BBPATH .= ":${LAYERDIR}"

LAYERDIR_qcom_connectivity := "${LAYERDIR}"

BBFILES += "${LAYERDIR}/recipes-*/*/*.bb \
            ${LAYERDIR}/recipes-*/*/*.bbappend"

BBFILE_COLLECTIONS += "qcom-connectivity"
BBFILE_PATTERN_qcom-connectivity := "^${LAYERDIR}/"
BBFILE_PRIORITY_qcom-connectivity = "7"

LAYERDEPENDS_qcom-connectivity = "qcom qcom-distro"
LAYERSERIES_COMPAT_qcom-connectivity = "wrynose"
```
